## build/conf/bblayers.conf
```bitbake
# POKY_BBLAYERS_CONF_VERSION is increased each time build/conf/bblayers.conf
# changes incompatibly
POKY_BBLAYERS_CONF_VERSION = "2"

BBPATH = "${TOPDIR}"
BBFILES ?= ""

BBLAYERS ?= " \
  /home/jan/projs/kirkstone-jetson/poky/meta \
  /home/jan/projs/kirkstone-jetson/poky/meta-poky \
  /home/jan/projs/kirkstone-jetson/poky/meta-yocto-bsp \
  /home/jan/projs/kirkstone-jetson/meta-tegra \
  "
```
